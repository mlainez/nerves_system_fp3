## packages/cam-grab/Config.in
```kconfig
config BR2_PACKAGE_CAM_GRAB
	bool "cam-grab"
	help
	  Small V4L2 camera capture tool for the msm8953 CAMSS pipeline
	  on the Fairphone 3+.

	  The CAMSS RDI lane only emits MIPI 10-bit packed Bayer (fourcc
	  `pgAA` / V4L2_PIX_FMT_SGRBG10P). GStreamer 1.24's v4l2src has
	  no mapping for this format and its `bayer2rgbneon` plugin only
	  consumes unpacked Bayer (`*10le`). cam-grab opens the V4L2
	  multi-planar device, captures frames, unpacks each 5-byte
	  group (4 packed 10-bit pixels) into 4 16-bit little-endian
	  values, and writes the result to stdout in `video/x-bayer,
	  format=grbg10le` byte order — ready to pipe into a GStreamer
	  pipeline via `fdsrc fd=0`.
```

## packages/cam-snap/Config.in
```kconfig
config BR2_PACKAGE_CAM_SNAP
	bool "cam-snap"
	depends on BR2_PACKAGE_BAYER2RGB_NEON_ARCH_SUPPORTS
	select BR2_PACKAGE_BAYER2RGB_NEON
	select BR2_PACKAGE_JPEG
	help
	  Single-shot still-image tool for the msm8953 CAMSS pipeline.

	  msm8953 CAMSS only emits raw 10-bit packed Bayer; without any
	  ISP processing the output is heavily green-tinted, washed out,
	  and exposed wrong. cam-snap implements a small software ISP
	  end-to-end:

	    * Set sensor exposure / analogue gain via V4L2 controls
	    * Capture an SGRBG10P frame via mplane mmap
	    * Unpack 10-bit packed → linear 16-bit Bayer
	    * Black-level subtract (64 in 10-bit space)
	    * Gray-world auto white balance (per-channel digital gain)
	    * NEON-accelerated bilinear demosaic via libbayer2rgb-neon
	    * 3x3 sRGB color-correction matrix
	    * Gamma 2.2 + clip to 8-bit RGB
	    * JPEG encode via libjpeg-turbo

	  Output is a viewable JPEG saved to disk. Designed to be called
	  from Elixir (via :ex_camera) so a higher-level layer can drive
	  capture, retries, sensor-control overrides, etc.
```

## packages/fp3-firmware/Config.in
```kconfig
config BR2_PACKAGE_FP3_FIRMWARE
	bool "fp3-firmware [FP3+ only]"
	help
	  This package provides all firmware binaries for Fairphone 3,
	  including DTS firmware-name symlinks and the ADSP sensor
	  registry (sns.reg) for the in-kernel QCOM_SNS_REG driver.
```

## packages/hexagonrpc/Config.in
```kconfig
config BR2_PACKAGE_HEXAGONRPC
	bool "hexagonrpc [Qualcomm generic]"
	help
	  Hexagon FastRPC userspace implementation providing hexagonrpcd
	  (reverse tunnel daemon for DSP file/memory serving), chrecd
	  (Context Hub Runtime Environment client), and libhexagonrpc.

	  https://github.com/linux-msm/hexagonrpc
```

## packages/qrtr/Config.in
```kconfig
config BR2_PACKAGE_QRTR
        bool "qrtr [Qualcomm generic]"
        help
          Userspace reference for net/qrtr in the Linux kernel.
```

## packages/rumble/Config.in
```kconfig
config BR2_PACKAGE_RUMBLE
	bool "rumble [Generic]"
	help
	  Plays one force-feedback rumble effect on the first input device
	  that supports FF_RUMBLE, such as a phone vibrator:

	    rumble [-d /dev/input/eventN] DURATION_MS [STRENGTH]
```
